## 06_SPI/SpiBasic/main/Kconfig.projbuild
```kconfig
menu "SPI Basic Loopback Configuration"

    config SPI_MOSI_GPIO
        int "MOSI GPIO Pin"
        default 11
        help
            GPIO pin for SPI Master Out Slave In (MOSI).

    config SPI_MISO_GPIO
        int "MISO GPIO Pin"
        default 13
        help
            GPIO pin for SPI Master In Slave Out (MISO).

    config SPI_SCLK_GPIO
        int "SCLK GPIO Pin"
        default 12
        help
            GPIO pin for SPI Serial Clock (SCLK).

    config SPI_CS_GPIO
        int "CS GPIO Pin"
        default 10
        help
            GPIO pin for SPI Chip Select (CS).

    config SPI_CLOCK_SPEED_HZ
        int "SPI Clock Speed (Hz)"
        default 10000000
        help
            Clock speed in Hz (e.g. 10000000 = 10 MHz).

    config SPI_MODE_SELECT
        int "SPI Mode (0, 1, 2, 3)"
        range 0 3
        default 0
        help
            SPI Mode:
            0: CPOL=0, CPHA=0 (Sample on rising edge)
            1: CPOL=0, CPHA=1 (Sample on falling edge)
            2: CPOL=1, CPHA=0 (Sample on falling edge)
            3: CPOL=1, CPHA=1 (Sample on rising edge)

endmenu
```

## 06_SPI/St7796Basic/main/Kconfig.projbuild
```kconfig
menu "ST7796 LCD Configuration"

    config LCD_MOSI_GPIO
        int "MOSI (SDA) GPIO Pin"
        default 11
        help
            GPIO connected to ST7796 SDA/MOSI pin.

    config LCD_MISO_GPIO
        int "MISO GPIO Pin"
        default 13
        help
            GPIO connected to ST7796 MISO pin (-1 if not used).

    config LCD_SCLK_GPIO
        int "SCLK (SCL) GPIO Pin"
        default 12
        help
            GPIO connected to ST7796 SCL/SCK pin.

    config LCD_CS_GPIO
        int "CS GPIO Pin"
        default 10
        help
            GPIO connected to ST7796 CS pin (-1 if tied to GND).

    config LCD_DC_GPIO
        int "DC (Data/Command) GPIO Pin"
        default 9
        help
            GPIO connected to ST7796 DC pin.

    config LCD_RST_GPIO
        int "RST (Reset) GPIO Pin"
        default 14
        help
            GPIO connected to ST7796 RES/RST pin (-1 if tied to 3.3V).

    config LCD_BLK_GPIO
        int "Backlight (BLK) GPIO Pin"
        default 2
        help
            GPIO connected to ST7796 BLK pin (GPIO 2 on typical board).

    config LCD_WIDTH
        int "Screen Width (Pixels)"
        default 480
        help
            TFT LCD horizontal resolution in pixels.

    config LCD_HEIGHT
        int "Screen Height (Pixels)"
        default 320
        help
            TFT LCD vertical resolution in pixels.

    config LCD_SPI_CLOCK_HZ
        int "SPI Clock Speed (Hz)"
        default 80000000
        help
            SPI Clock speed (e.g. 80000000 = 80 MHz, 40000000 = 40 MHz).

endmenu
```

## 06_SPI/St7796Driver/main/Kconfig.projbuild
```kconfig
menu "ST7796 Driver Configuration"

    config LCD_MOSI_GPIO
        int "MOSI (SDA) GPIO Pin"
        default 11
        help
            GPIO connected to ST7796 SDA/MOSI pin.

    config LCD_MISO_GPIO
        int "MISO GPIO Pin"
        default 13
        help
            GPIO connected to ST7796 MISO pin (-1 if not used).

    config LCD_SCLK_GPIO
        int "SCLK (SCL) GPIO Pin"
        default 12
        help
            GPIO connected to ST7796 SCL/SCK pin.

    config LCD_CS_GPIO
        int "CS GPIO Pin"
        default 10
        help
            GPIO connected to ST7796 CS pin (-1 if tied to GND).

    config LCD_DC_GPIO
        int "DC (Data/Command) GPIO Pin"
        default 9
        help
            GPIO connected to ST7796 DC/RS pin.

    config LCD_RST_GPIO
        int "RST (Reset) GPIO Pin"
        default 14
        help
            GPIO connected to ST7796 RES/RST pin (-1 if tied to 3.3V).

    config LCD_BLK_GPIO
        int "Backlight (BLK) GPIO Pin"
        default 2
        help
            GPIO connected to ST7796 BLK/LED pin (GPIO 2 on typical board).

    config LCD_H_RES
        int "Screen Horizontal Resolution (Pixels)"
        default 480
        help
            Width of the ST7796 display (e.g. 480 for Landscape, 320 for Portrait).

    config LCD_V_RES
        int "Screen Vertical Resolution (Pixels)"
        default 320
        help
            Height of the ST7796 display (e.g. 320 for Landscape, 480 for Portrait).

    config LCD_PIXEL_CLOCK_HZ
        int "SPI Pixel Clock (Hz)"
        default 80000000
        help
            SPI Clock speed (e.g. 80000000 = 80 MHz, 40000000 = 40 MHz).

endmenu
```
